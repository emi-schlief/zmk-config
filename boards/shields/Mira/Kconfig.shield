## boards/shields/Mira/Kconfig.shield
```kconfig
config SHIELD_MIRA
	def_bool $(shields_list_contains,Mira)

config SHIELD_MIRA_LEFT
	def_bool $(shields_list_contains,Mira_Left)

config SHIELD_MIRA_RIGHT
	def_bool $(shields_list_contains,Mira_Right)
```

## boards/shields/mira/Kconfig.defconfig
```kconfig
if SHIELD_MIRA_LEFT

config ZMK_KEYBOARD_NAME
	default "Mira"

config ZMK_SPLIT_ROLE_CENTRAL
	default y

endif

if SHIELD_MIRA_LEFT || SHIELD_MIRA_RIGHT

config ZMK_SPLIT
	default y

endif
```

## boards/shields/mira/Kconfig.shield
```kconfig
config SHIELD_MIRA_LEFT
	def_bool $(shields_list_contains,mira_left)

config SHIELD_MIRA_RIGHT
	def_bool $(shields_list_contains,mira_right)
```
