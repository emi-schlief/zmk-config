#include <behaviors.dtsi>
#include <dt-bindings/zmk/keys.h>
#include <dt-bindings/zmk/bt.h>

/ {
	keymap {
		compatible = "zmk,keymap";

        default_layer {
        	bindings = <
			&kp A
			&kp B
			&kp C
			&kp D
			&kp E
			&kp F
			&kp M
			&kp N
			&kp O
			&kp A
			&kp Q
			&kp R
			&kp Y
			&kp Z
			&kp KP_N0
			&kp KP_N4
			&kp KP_N5
			&kp KP_N1
            >;
        };
    };
};